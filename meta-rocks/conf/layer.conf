## meta-rocks/conf/layer.conf
```bitbake
# We have a conf and classes directory, add to BBPATH
BBPATH .= ":${LAYERDIR}"

# We have recipes-* directories, add to BBFILES
BBFILES += "${LAYERDIR}/recipes-*/*/*.bb \
            ${LAYERDIR}/recipes-*/*/*.bbappend"

BBFILE_COLLECTIONS += "rocks"
BBFILE_PATTERN_rocks = "^${LAYERDIR}/"
BBFILE_PRIORITY_rocks = "6"

LAYERDEPENDS_rocks = "core kria"
LAYERSERIES_COMPAT_rocks = "scarthgap"

hostname:pn-base-files = "kr260-01-pbl.ee.ethz.ch"

# Optional device-tree fragment: PS Ethernet (gem0) over SGMII
DT_ENABLE_GEM0 = "1"

#bitstream, dt overlay, networking
IMAGE_INSTALL:append = " rocks-fw"
IMAGE_INSTALL:append = " dfx-default"
IMAGE_INSTALL:append = " network-default"
#build
IMAGE_INSTALL:append = " packagegroup-core-buildessential packagegroup-core-buildessential-dev"
#libmetal
IMAGE_INSTALL:append = " libmetal"
IMAGE_INSTALL:append = " libmetal-dev"
IMAGE_INSTALL:append = " libsysfs"
#packet manager
IMAGE_INSTALL:append = " parted"
IMAGE_INSTALL:append = " dosfstools"
IMAGE_INSTALL:append = " dnf"
IMAGE_FEATURES:append = " package-management"
#docker and git"
IMAGE_INSTALL:append = " docker-compose"
IMAGE_INSTALL:append = " git"
# rdma
IMAGE_INSTALL:append = " xrping"
IMAGE_INSTALL:append = " rdma"
IMAGE_INSTALL:append = " rdma-test"
```
